## main/Kconfig.projbuild
```kconfig
menu "MQTT Configuration"

    config BROKER_URL
        string "Broker URL"
        default "mqtt://mqtt.eclipse.org"
        help
            URL of the broker to connect to

    config BROKER_URL_FROM_STDIN
        bool
        default y if BROKER_URL = "FROM_STDIN"

endmenu

menu "OTA Configuration"

    config FIRMWARE_UPGRADE_URL
        string "Firmware Upgrade URL"
        default "https://192.168.2.106:8070/hello-world.bin"
        help
            URL of server which hosts the firmware image.

endmenu
```
